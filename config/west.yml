## config/west.yml
```yaml
manifest:
  remotes:
    - name: slicemk
      url-base: https://github.com/slicemk
  projects:
    - name: zmk
      remote: slicemk
      revision: main
      import: app/west.yml
      clone-depth: 1
  self:
    path: config
```
